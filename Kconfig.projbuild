## Kconfig.projbuild
```kconfig
menu "ChronoLink HAL Board Pins"

config BOARD_LCD_CS
    int "LCD CS GPIO"
    range 0 48
    default 12
    help
        Chip-select pin for ST7796S display SPI device.

config BOARD_LCD_DC
    int "LCD D/C GPIO"
    range 0 48
    default 16
    help
        Data/Command select pin for ST7796S display.

config BOARD_LCD_RST
    int "LCD Reset GPIO"
    range 0 48
    default 17
    help
        Reset pin for ST7796S display.

config BOARD_LCD_BL
    int "LCD Backlight GPIO"
    range 0 48
    default 25
    help
        Backlight control pin for ST7796S display.

config BOARD_I2C_SDA
    int "I2C SDA GPIO"
    range 0 48
    default 21
    help
        SDA pin for HAL I2C master.

config BOARD_I2C_SCL
    int "I2C SCL GPIO"
    range 0 48
    default 22
    help
        SCL pin for HAL I2C master.

config BOARD_AUDIO_I2S_BCLK
    int "Audio I2S BCLK GPIO"
    range 0 48
    default 26
    help
        I2S bit clock pin for the MAX98357A amplifier.
        Was previously a hardcoded fallback #define inside
        hal_audio_max98357a.c with no Kconfig control at all.

config BOARD_AUDIO_I2S_WS
    int "Audio I2S WS (LRCLK) GPIO"
    range 0 48
    default 25
    help
        I2S word-select (LRCLK) pin for the MAX98357A amplifier.

config BOARD_AUDIO_I2S_DOUT
    int "Audio I2S DOUT GPIO"
    range 0 48
    default 27
    help
        I2S data-out pin for the MAX98357A amplifier.

config BOARD_AUDIO_SD_MODE
    int "Audio SD_MODE GPIO (-1 to disable)"
    range -1 48
    default -1
    help
        Optional shutdown/mode-select pin for the MAX98357A.
        Set to -1 if not wired (amplifier is always enabled).

endmenu


menu "ChronoLink Display Configuration"

choice BOARD_DISPLAY_TYPE
    prompt "Select display driver"
    default BOARD_DISPLAY_ST7796S
    help
        Choose which display backend ChronoLink HAL should use.
        Only one display driver is compiled into the firmware.

config BOARD_DISPLAY_NONE
    bool "No display"
    help
        Disable all display drivers. Useful for headless builds.

config BOARD_DISPLAY_ST7796S
    bool "ST7796S SPI LCD"
    help
        Use the ST7796S TFT LCD driver.

config BOARD_DISPLAY_MAX7219
    bool "MAX7219 LED Matrix"
    help
        Use the MAX7219 LED matrix driver.

config BOARD_DISPLAY_REMOTE
    bool "Remote display (future)"
    help
        Use remote display backend (WiFi/HTTP/MQTT).

endchoice

endmenu
```

## components/audio_test/Kconfig
```kconfig
menu "Audio Test"

config AUDIO_TEST_ENABLE
    bool "Enable audio test component"
    default n
    help
      When enabled, the audio_test component is compiled and app_main()
      runs the audio self-test at boot. Leave disabled for normal builds.

config AUDIO_TEST_SIMULATION
    bool "Simulation mode (no hardware)"
    depends on AUDIO_TEST_ENABLE
    default n
    help
      When enabled, audio_test does not touch I2S hardware -- it logs
      the pins and configuration that would be used and sleeps for the
      duration of each tone. Useful for CI builds and development on
      machines without a speaker attached.

      When disabled, audio_test runs the real HAL_Audio_Init /
      HAL_Audio_Play path against the MAX98357A amplifier.

endmenu
```

## components/chronolink_hal/Kconfig
```kconfig
menu "ChronoLink HAL options"

config CHRONOLINK_USE_MOCK_DISPLAY
    bool "Use mock display driver for local testing"
    default n
    help
      When enabled, the mock display driver will be compiled in addition to
      the real drivers for local builds without hardware.

choice CHRONOLINK_HAL_DISPLAY_BACKEND
    prompt "Display Backend"
    default CHRONOLINK_HAL_DISPLAY_BACKEND_NONE
    help
        Select the display panel driver backend. The router in
        hal_display.c dispatches all HAL_Display_* calls to the
        selected backend.

    config CHRONOLINK_HAL_DISPLAY_BACKEND_NONE
        bool "None (headless mode)"
        help
            No local display. HAL_Display_Init() returns HAL_OK
            so the OS can boot without a panel.

    config CHRONOLINK_HAL_DISPLAY_BACKEND_ST7796S
        bool "ST7796S 320x480 TFT (SPI)"
        help
            ST7796S 320x480 RGB565 TFT over SPI. Requires
            BOARD_LCD_CS, BOARD_LCD_DC, BOARD_LCD_RST, BOARD_LCD_BL
            and SPI MOSI/MISO/SCLK pins in board_pins.h.

    config CHRONOLINK_HAL_DISPLAY_BACKEND_MAX7219
        bool "MAX7219 LED Matrix"
        help
            MAX7219 8x8 LED matrix chain.

    config CHRONOLINK_HAL_DISPLAY_BACKEND_REMOTE
        bool "Remote Display"
        help
            Remote display over network/BLE.
endchoice

config CHRONOLINK_HAL_DISPLAY_MUTEX
    bool "Enable display mutex"
    default y
    depends on !CHRONOLINK_HAL_DISPLAY_BACKEND_NONE
    help
        Protect all display operations with a FreeRTOS mutex.
        Strongly recommended when multiple tasks access the display.
        Disable only on single-task systems to save a few bytes.

menu "ST7796S Driver"
    depends on CHRONOLINK_HAL_DISPLAY_BACKEND_ST7796S

    config CHRONOLINK_HAL_ST7796S_SPI_HOST_NUM
        int "SPI Host Number"
        default 2
        range 1 3
        help
            SPI peripheral: 1=SPI1, 2=SPI2 (HSPI), 3=SPI3 (VSPI).
            SPI2 is the typical choice on ESP32.

    config CHRONOLINK_HAL_ST7796S_SPI_CLOCK_MHZ
        int "SPI Clock Speed (MHz)"
        default 20
        range 1 80
        help
            SPI clock frequency in MHz. 20 MHz is safe for most panels.

    config CHRONOLINK_HAL_ST7796S_DMA_CHUNK_KB
        int "DMA Chunk Size (KB)"
        default 8
        range 1 64
        help
            DMA transfer chunk size in kilobytes.

    config CHRONOLINK_HAL_ST7796S_WIDTH
        int "Panel Width (pixels)"
        default 320

    config CHRONOLINK_HAL_ST7796S_HEIGHT
        int "Panel Height (pixels)"
        default 480
endmenu

menu "Chronolink HAL Pin Overrides"

config PDL_PIN_I2C_SCL
    int "I2C SCL pin"
    default 22
    help
      GPIO number for I2C SCL. Override for your board.

config PDL_PIN_I2C_SDA
    int "I2C SDA pin"
    default 21
    help
      GPIO number for I2C SDA. Override for your board.

config PDL_I2C_FREQ_HZ
    int "I2C frequency (Hz)"
    default 100000
    help
      I2C clock frequency.

endmenu

endmenu
```

## main/Kconfig.projbuild
```kconfig
menu "ChronoLink HAL Board Pins"

config BOARD_LCD_CS
    int "LCD CS GPIO"
    range -1 48
    default 7
    help
        Chip-select pin for ST7796S display SPI device. PCB: IO7.

config BOARD_LCD_DC
    int "LCD D/C GPIO"
    range -1 48
    default 10
    help
        Data/Command select pin for ST7796S display. PCB: IO10.

config BOARD_LCD_RST
    int "LCD Reset GPIO"
    range -1 48
    default 16
    help
        Reset pin for ST7796S display. PCB: IO16.

config BOARD_LCD_BL
    int "LCD Backlight GPIO"
    range -1 48
    default 8
    help
        Backlight control pin for ST7796S display. PCB: IO8.

config BOARD_I2C_SDA
    int "I2C SDA GPIO"
    range -1 48
    default 18
    help
        SDA pin for HAL I2C master. PCB: IO18.

config BOARD_I2C_SCL
    int "I2C SCL GPIO"
    range -1 48
    default 17
    help
        SCL pin for HAL I2C master. PCB: IO17.

config BOARD_AUDIO_I2S_BCLK
    int "Audio I2S BCLK GPIO"
    range -1 48
    default 47
    help
        I2S bit clock pin for the MAX98357A amplifier. PCB: IO47.

config BOARD_AUDIO_I2S_WS
    int "Audio I2S WS (LRCLK) GPIO"
    range -1 48
    default 48
    help
        I2S word-select (LRCLK) pin for the MAX98357A amplifier. PCB: IO48.

config BOARD_AUDIO_I2S_DOUT
    int "Audio I2S DOUT GPIO"
    range -1 48
    default 21
    help
        I2S data-out pin for the MAX98357A amplifier. PCB: IO21.

config BOARD_AUDIO_SD_MODE
    int "Audio SD_MODE GPIO (-1 to disable)"
    range -1 48
    default -1
    help
        Optional shutdown/mode-select pin for the MAX98357A.
        PCB v4 leaves this unconnected, so keep at -1.

endmenu
```
